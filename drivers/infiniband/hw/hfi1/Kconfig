## drivers/infiniband/hw/hfi1/Kconfig
```kconfig
# SPDX-License-Identifier: GPL-2.0-only
config INFINIBAND_HFI1
	tristate "Cornelis OPX Gen1 support"
	depends on X86_64 && INFINIBAND_RDMAVT && I2C && !UML
	depends on PCI_IOV
	select MMU_NOTIFIER
	select CRC32
	select I2C_ALGOBIT
	help
	This is a low-level driver for Cornelis OPX Gen1 adapter.
config HFI1_DEBUG_SDMA_ORDER
	bool "HFI1 SDMA Order debug"
	depends on INFINIBAND_HFI1
	default n
	help
	This is a debug flag to test for out of order
	sdma completions for unit testing
config SDMA_VERBOSITY
	bool "Config SDMA Verbosity"
	depends on INFINIBAND_HFI1
	default n
	help
	This is a configuration flag to enable verbose
	SDMA debug
config HFI1_NVIDIA
	bool "Build NVIDIA memory-pinning code"
	depends on INFINIBAND_HFI1
	default n
	help
	  Build hfi1 NVIDIA GPU memory-pinning code for user_sdma. Requires
	  NVIDIA proprietary driver header files.
config HFI1_AMD
	bool "Build AMD memory-pinning code"
	depends on INFINIBAND_HFI1
	select NEED_SG_DMA_LENGTH
	default n
	help
	  Build hfi1 AMD GPU memory-pinning code for user_sdma. Requires AMD
	  ROCk out-of-tree driver header files.
config HFI1_AMD_SOFTDEP
	bool "Softdep on amdgpu and use symbol_get() to link"
	depends on HFI1_AMD
	default y
	help
	  Add amdgpu as a soft dependency and get amdkfd_query_rdma_interface()
	  using symbol_get(). This allows hfi1 to load even if amdgpu is not
	  available. Does not work on kernels where symbol_get() of
	  non-EXPORT_SYMBOL_GPL() symbols fails. This is at present necessary
	  when amdgpu Module.symvers is not available when hfi1 is built.
config HFI1_NVIDIA_P2P_MEMCPY
	bool "bulksvc: use NVIDIA p2p for CPU-driven copies"
	default n
	help
	  Use NVIDIA's p2p kernel API to pin GPU pages for CPU-driven copies.
	  Applies only to hfi1-bulksvc code. When 'y', creates a dependency
	  on the nvidia module.
config HFI1_NVIDIA_P2P_MEMCPY_SOFTDEP
	bool "bulksvc: use softdep on nvidia instead of hard dep"
	depends on HFI1_NVIDIA_P2P_MEMCPY
	default y
	help
	  For P2P memcpy support, depend on 'nvidia' as a soft dependency
	  rather than a regular dependency. This will allow hfi1 to load even
	  if 'nvidia' is not available though NVIDIA P2P support will not be
	  available.
```
